## conf/layer.conf
```bitbake
# We have a conf and classes directory, add to BBPATH
BBPATH .= ":${LAYERDIR}"

# We have a packages directory, add to BBFILES
BBFILES += "${LAYERDIR}/recipes-*/*/*.bb \
            ${LAYERDIR}/recipes-*/*/*.bbappend"

BBFILE_COLLECTIONS += "fsl-bsp-additional"
BBFILE_PATTERN_fsl-bsp-additional := "^${LAYERDIR}"
BBFILE_PRIORITY_fsl-bsp-additional = "4"
```
